## components/httpServer/Kconfig.projbuild
```kconfig
menu "httpServer Configuration"
    
    config BASIC_AUTH
        bool "Basic Authentication"
        default n
        help 
            Basic Authentication is a method for an HTTP user agent to provide a user name and a password when making a request.
            It is the simplest technique for enforcing access controls to web resources, because it doesn't require cookies, session
            identifiers, or login pages; rather, it uses standard fields in the HTTP header;
            (Basic Authentication is not encrypted channel and it is also easy to retrieve credentials as they are sent in plain text format)
      
    config BASIC_AUTH_USERNAME
        string "Basic Authenticate Username"
        depends on BASIC_AUTH
        default "esp 32"
        help 
            The client's username used for basic authentication
        
    config BASIC_AUTH_PASSWORD
        string "Basic Authenticate Password"
        depends on BASIC_AUTH
        default "ESP32WebServer"
        help 
            The client's password used for basic authentication

endmenu
```

## components/wifiStation/Kconfig.projbuild
```kconfig
menu "THE HARALD - WIFI Configuration"

    config ESP_WIFI_SSID
        string "WiFi SSID"
        default "SOCIEDADE_DO_ABACAXI"
        help
            SSID (network name) for the example to connect to.

    config ESP_WIFI_PASSWORD
        string "WiFi Password"
        default "100s3nh44"
        help
            WiFi password (WPA or WPA2) for the example to use.

    config ESP_MAXIMUM_RETRY
        int "Maximum retry"
        default 5
        help
            Set the Maximum retry to avoid station reconnecting to the AP unlimited when the AP is really inexistent.
endmenu
```
